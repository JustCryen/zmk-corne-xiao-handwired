## config/west.yml
```yaml
manifest:
  remotes:
    - name: zmkfirmware
      url-base: https://github.com/zmkfirmware
#    - name: caksoylar
#      url-base: https://github.com/caksoylar
    - name: tokyo2006
      url-base: https://github.com/tokyo2006
    - name: amgskobo
      url-base: https://github.com/amgskobo
    - name: 8en6
      url-base: https://github.com/8en6
    - name: karbou12
      url-base: https://github.com/karbou12
  projects:
    - name: zmk
      remote: zmkfirmware
      revision: main
      import: app/west.yml
#    - name: zmk-rgbled-widget
#      remote: caksoylar
#      revision: main
    - name: zmk-nice-oled
      remote: tokyo2006
      revision: main
    - name: cirque-input-module
      remote: tokyo2006
      revision: main
    - name: zmk-input-inertia
      remote: amgskobo
      revision: main
    - name: zmk-input-processor-scroll-inertia
      remote: 8en6
      revision: main
    - name: zmk-trackball-shift
      remote: karbou12
      revision: main
  self:
    path: config
```
